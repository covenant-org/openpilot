VERSION "0.0.00"

BO_ 613 CMD: 4 XXX
  SG_ ANGLE : 7|16@0- (-0.1,0) [-3600|3600] "" XXX
  SG_ SPEED : 23|16@0+ (0.01,0) [0|10000] "" XXX

BO_ 614 DRONE_DATA: 4 XXX
  SG_ ANGLE : 7|16@0- (-0.1,0) [-3600|3600] "" XXX
  SG_ SPEED : 23|16@0+ (0.01,0) [0|10000] "" XXX
