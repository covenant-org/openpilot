VERSION "0.0.00"

BO_ 613 CMD: 8 XXX
  SG_ ANGLE : 7|16@0- (1,0) [-1000|1000] "" XXX
  SG_ SPEED : 23|16@0- (1,0) [-1000|1000] "" XXX

BO_ 614 DRONE_DATA: 2 XXX
  SG_ YAW : 7|16@0- (1,0) [-1000|1000] "" XXX
